## Kconfig
```kconfig
config ZMK_BEHAVIOR_OYAYUBI
    bool "Enable oyayubi (NICOLA thumb shift) behavior"
    default y
    help
      Enable NICOLA thumb shift input behavior for Layer 7/8
```

## dts/bindings/behaviors/zmk,behavior-oyayubi.yaml
```yaml
description: NICOLA Oyayubi Shift Behavior
compatible: "zmk,behavior-oyayubi"
include: one_param.yaml
```
